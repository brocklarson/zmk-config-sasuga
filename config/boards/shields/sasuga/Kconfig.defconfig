## config/boards/shields/sasuga/Kconfig.defconfig
```kconfig
# Copyright (c) 2020 The ZMK Contributors
# SPDX-License-Identifier: MIT

if SHIELD_SASUGA_LEFT

config ZMK_KEYBOARD_NAME
    default "Sasuga"

config ZMK_SPLIT_ROLE_CENTRAL
    default y

endif

if SHIELD_SASUGA_LEFT || SHIELD_SASUGA_RIGHT

config ZMK_SPLIT
    default y

endif
```

## config/boards/shields/sasuga/Kconfig.shield
```kconfig
# Copyright (c) 2020 The ZMK Contributors
# SPDX-License-Identifier: MIT

config SHIELD_SASUGA_LEFT
    def_bool $(shields_list_contains,sasuga_left)

config SHIELD_SASUGA_RIGHT
    def_bool $(shields_list_contains,sasuga_right)
```
